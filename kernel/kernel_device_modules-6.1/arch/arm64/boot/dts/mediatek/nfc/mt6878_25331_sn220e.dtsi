/**********************************************************************************
* Copyright (c)  2008-2020  Guangdong oplus Mobile Comm Corp., Ltd
*
***********************************************************************************/
&odm {
	nfc_chipset:nfc_chipset {
        compatible = "oplus-nfc-chipset";
        chipset-25331 = "SN220E";
	};
};


&i2c3 {
    status = "okay";
    clock-frequency = <400000>;
    nq@29 {
        compatible = "nxp,sn-nci";
        reg = <0x29>;
        nxp,sn-irq = <&pio 2 0x0>;
        nxp,sn-ven-rstn = <&pio 40 0x0>;
        nxp,sn-clkreq = <&pio 151 0x0>;
        interrupt-parent = <&pio>;
    };
};